## main/Kconfig.projbuild
```kconfig
menu "CarPlay Relay"

    menu "SoftAP"

        config CARPLAY_AP_SSID
            string "Access point SSID"
            default "ESP32-CarPlay"
            help
                SSID advertised by the ESP32 SoftAP. Maximum length is 32 bytes.

        config CARPLAY_AP_PASSWORD
            string "Access point WPA2 password"
            default ""
            help
                WPA2-PSK password. Set a value between 8 and 63 characters.
                The password is intentionally empty by default and must not be
                committed in sdkconfig or shared in source control.

        config CARPLAY_AP_CHANNEL
            int "Access point channel"
            range 1 13
            default 6
            help
                2.4 GHz channel used by the SoftAP.

        config CARPLAY_AP_MAX_STA
            int "Maximum SoftAP clients"
            range 2 8
            default 2
            help
                The MVP needs one iPhone and one head-unit browser client.

    endmenu

    menu "WebRTC test media"

        config CARPLAY_WEBRTC_TEST_STREAM
            bool "Send an embedded synthetic H.264 test stream"
            default y
            help
                Development-only M2 stream. Disable when forwarding a real
                CarPlay video source.

    endmenu

    menu "AirPlay receiver"

        config AIRPLAY_PAIRING_CODE
            string "AirPlay Pair-Setup code"
            default "3939"
            help
                Development Pair-Setup code used by the software AirPlay identity.
                Change this before testing on a shared network.

    endmenu

endmenu
```

## sdkconfig.defaults
```kconfig
CONFIG_HTTPD_WS_SUPPORT=y
CONFIG_LWIP_MAX_SOCKETS=16
CONFIG_MBEDTLS_SSL_PROTO_DTLS=y
CONFIG_MBEDTLS_SSL_DTLS_SRTP=y
CONFIG_BT_ENABLED=y
CONFIG_BT_BLUEDROID_ENABLED=y
CONFIG_BT_CLASSIC_ENABLED=y
CONFIG_BT_SPP_ENABLED=y
CONFIG_BT_SDP_COMMON_ENABLED=y
CONFIG_BT_ACL_CONNECTIONS=1
CONFIG_MBEDTLS_CHACHA20_C=y
CONFIG_MBEDTLS_POLY1305_C=y
CONFIG_MBEDTLS_CHACHAPOLY_C=y
CONFIG_MBEDTLS_PKCS7_C=y
CONFIG_MBEDTLS_X509_CRL_PARSE_C=y
CONFIG_MBEDTLS_HKDF_C=y
CONFIG_PARTITION_TABLE_SINGLE_APP_LARGE=y
```

## sdkconfig.defaults.4mb
```kconfig
CONFIG_HTTPD_WS_SUPPORT=y
CONFIG_LWIP_MAX_SOCKETS=16
CONFIG_MBEDTLS_SSL_PROTO_DTLS=y
CONFIG_MBEDTLS_SSL_DTLS_SRTP=y
CONFIG_BT_ENABLED=y
CONFIG_BT_BLUEDROID_ENABLED=y
CONFIG_BT_CLASSIC_ENABLED=y
CONFIG_BTDM_CTRL_MODE_BR_EDR_ONLY=y
# The relay uses iAP2/SPP over Classic BR/EDR and has no BLE/GATT API users.
# CONFIG_BT_BLE_ENABLED is not set
CONFIG_BT_SPP_ENABLED=y
CONFIG_BT_SDP_COMMON_ENABLED=y
CONFIG_BT_ACL_CONNECTIONS=1
CONFIG_MBEDTLS_CHACHA20_C=y
CONFIG_MBEDTLS_POLY1305_C=y
CONFIG_MBEDTLS_CHACHAPOLY_C=y
CONFIG_MBEDTLS_PKCS7_C=y
CONFIG_MBEDTLS_X509_CRL_PARSE_C=y
CONFIG_MBEDTLS_HKDF_C=y
CONFIG_ESPTOOLPY_FLASHSIZE_4MB=y
CONFIG_ESPTOOLPY_FLASHSIZE="4MB"
CONFIG_PARTITION_TABLE_CUSTOM=y
CONFIG_PARTITION_TABLE_CUSTOM_FILENAME="partitions_4mb.csv"
CONFIG_PARTITION_TABLE_OFFSET=0x8000
CONFIG_PARTITION_TABLE_MD5=y
```
